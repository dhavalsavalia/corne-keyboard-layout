## config/west.yml
```yaml
manifest:
  remotes:
    - name: zmkfirmware
      url-base: https://github.com/zmkfirmware
    - name: urob
      url-base: https://github.com/urob
  projects:
    - name: zmk
      remote: zmkfirmware
      revision: 8266433d6b85cfecf57a4ba48e27e1eebb3de7b2
      import: app/west.yml
    - name: zmk-helpers
      remote: urob
      revision: 68e63aad6fb39c01c1d8b945156d6dd69fa480ef
  self:
    path: config
```
